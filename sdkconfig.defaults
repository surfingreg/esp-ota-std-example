## sdkconfig.defaults
```kconfig
# Rust often needs a bit of an extra main task stack size compared to C (the default is 3K)
CONFIG_ESP_MAIN_TASK_STACK_SIZE=16000

# Use this to set FreeRTOS kernel tick frequency to 1000 Hz (100 Hz by default).
# This allows to use 1 ms granularity for thread sleeps (10 ms by default).
# CONFIG_FREERTOS_HZ=1000

# Workaround for https://github.com/espressif/esp-idf/issues/7631
# CONFIG_MBEDTLS_CERTIFICATE_BUNDLE=n
# CONFIG_MBEDTLS_CERTIFICATE_BUNDLE_DEFAULT_FULL=n

# https://docs.espressif.com/projects/esp-idf/en/latest/esp32/api-reference/kconfig-reference.html#application-rollback
CONFIG_BOOTLOADER_APP_ROLLBACK_ENABLE

# experimental
# https://docs.espressif.com/projects/esp-idf/en/latest/esp32/api-reference/kconfig-reference.html#partition-table
ESP_IDF_COMP_ESP_PARTITION_ENABLED
```
